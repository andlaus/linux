## Documentation/devicetree/bindings/net/can/linux,lin-serdev.yaml
```yaml
# SPDX-License-Identifier: (GPL-2.0-only OR BSD-2-Clause)
%YAML 1.2
---
$id: http://devicetree.org/schemas/net/can/linux,lin-serdev.yaml#
$schema: http://devicetree.org/meta-schemas/core.yaml#

title: Linux serdev LIN-Bus Support

description: |
  LIN-Bus support for UART devices equipped with LIN transceivers,
  utilizing the Serial Device Bus (serdev) interface.

  For more details on an adapter, visit: https://hexdev.de/hexlin#tty

properties:
  compatible:
    const: linux,lin-serdev

required:
  - compatible

examples:
  - |
    &uart2 {
      status = "okay";
      linbus {
        compatible = "linux,lin-serdev";
      };
    };
```
